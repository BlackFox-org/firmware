## general/package/qlink/Config.in
```kconfig
config BR2_PACKAGE_QLINK
	bool "Adaptive link (not enabled by default)"
	help
	  Controls the bitrate and other link parameters depending on the link quality.
	  https://github.com/Vulpisfoglia-dev/QLink
```
